## ports/zephyr/boards/nordic/madi_nrf52840/Kconfig.defconfig
```kconfig
# SPDX-License-Identifier: MIT

if BOARD_MADI_NRF52840

config HW_STACK_PROTECTION
	default ARCH_HAS_STACK_PROTECTION

config BT_CTLR
	default BT

endif # BOARD_MADI_NRF52840
```
